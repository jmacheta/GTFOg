## software/boards/arm/gtfog/Kconfig.defconfig
```kconfig
# Copyright (c) 2024 Nordic Semiconductor ASA
# SPDX-License-Identifier: Apache-2.0

if BOARD_GTFOG

config BOARD
	default "gtfog"

config BT_CTLR
   default BT


endif
```
