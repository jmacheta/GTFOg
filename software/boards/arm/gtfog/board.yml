## software/boards/arm/gtfog/board.yml
```yaml
board:
  name: gtfog
  full_name: GTFOg anti-fog fan controller
  vendor: jmacheta
  socs:
  - name: nrf52833
```

## software/firmware/tests/logic/testcase.yaml
```yaml
common:
  tags: gtfog
  platform_allow:
    - native_sim/native/64
  integration_platforms:
    - native_sim/native/64
tests:
  gtfog.logic: {}
```
