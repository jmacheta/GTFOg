## CMakeLists.txt
```
cmake_minimum_required(VERSION 3.20.0)
find_package(Zephyr REQUIRED HINTS $ENV{ZEPHYR_BASE})

project(gtfog_logic_tests LANGUAGES C CXX)

include(${CMAKE_CURRENT_LIST_DIR}/../../src/logic.cmake)

target_sources(app PRIVATE src/test_battery_model.cpp src/test_controller.cpp src/test_controller_machine.cpp src/test_gestures.cpp src/test_motion.cpp src/test_rf_test.cpp)
gtfog_add_logic(app)
```

## prj.conf
```kconfig
CONFIG_ZTEST=y
CONFIG_CPP=y
CONFIG_STD_CPP23=y
CONFIG_REQUIRES_FULL_LIBCPP=y
```

## src/fake_outputs.hpp
```c
#ifndef GTFOG_TESTS_FAKE_OUTPUTS_HPP
#define GTFOG_TESTS_FAKE_OUTPUTS_HPP

#include "controller.hpp"

#include <vector>

// Records everything the controller asks of the hardware.
struct fake_outputs final : gtfog::outputs {
  unsigned fan{999};
  bool strobe{true};
  std::vector<gtfog::signal> signals;
  bool powered_off{false};
  std::vector<gtfog::device_settings> saved;
  unsigned fan_calls{0};

  [[nodiscard]] auto saved_count() const -> int { return static_cast<int>(saved.size()); }

  void set_fan(unsigned percent) override {
    fan = percent;
    ++fan_calls;
  }
  void set_strobe(bool on) override { strobe = on; }
  void show(gtfog::signal s) override { signals.push_back(s); }
  void power_off() override { powered_off = true; }
  void settings_changed(gtfog::device_settings const &s) override { saved.push_back(s); }
};

#endif
```

## src/test_accel.cpp
```c
#include "accel.hpp"

#include <zephyr/ztest.h>

#include <array>
#include <optional>

using namespace gtfog;

ZTEST_SUITE(accel, nullptr, nullptr, nullptr, nullptr, nullptr);

ZTEST(accel, test_counts_to_milli_g) {
  zassert_equal(counts_to_milli_g(0), 0);
  zassert_equal(counts_to_milli_g(256), 998); // About 1 g.
  zassert_equal(counts_to_milli_g(-256), -998);
  zassert_equal(counts_to_milli_g(4095), 15970);  // +-16 g full scale fits int16.
  zassert_equal(counts_to_milli_g(32767), 15974); // A corrupt sample is clamped, not wrapped.
  zassert_equal(counts_to_milli_g(-32768), -15974);
}

ZTEST(accel, test_samples_per_packet) {
  zassert_equal(accel_samples_per_packet(23), 2); // Default ATT MTU: 20-byte payload.
  zassert_equal(accel_samples_per_packet(247), 40);
  zassert_equal(accel_samples_per_packet(517), 40);
  zassert_equal(accel_samples_per_packet(5), 0);
}

ZTEST(accel, test_pack_layout) {
  std::array<accel_sample, 2> samples{{{256, -256, 0}, {1, 2, -3}}};
  std::array<std::uint8_t, accel_header_size + 2 * accel_sample_size> out{};
  auto len = pack_accel(0x1234, 100, samples, out);
  zassert_equal(len, out.size());
  zassert_equal(out[0], 0x34);
  zassert_equal(out[1], 0x12);
  zassert_equal(out[2], 100);
  zassert_equal(out[3], 2);
  zassert_equal(static_cast<std::int16_t>(out[4] | out[5] << 8), 998);
  zassert_equal(static_cast<std::int16_t>(out[6] | out[7] << 8), -998);
  zassert_equal(static_cast<std::int16_t>(out[8] | out[9] << 8), 0);
  zassert_equal(static_cast<std::int16_t>(out[14] | out[15] << 8), -11); // -3 counts = -11.7 mg, truncated.
}

namespace {

// One second of samples whose magnitude alternates between 1 g and 1 g + `swing` counts: the deviation is half the swing.
auto classify_second(int swing) -> std::optional<activity_level> {
  activity_classifier classifier;
  std::array<accel_sample, 50> batch{};
  std::optional<activity_level> level;
  for(int half = 0; half != 2; ++half) {
    for(std::size_t i = 0; i != batch.size(); ++i) {
      batch[i] = {0, 0, static_cast<std::int16_t>(256 + (i % 2 == 0 ? 0 : swing))};
    }
    zassert_false(level.has_value(), "a level only after 100 samples");
    level = classifier.update(batch);
  }
  return level;
}

} // namespace

ZTEST(accel, test_activity_levels) {
  zassert_equal(classify_second(0), activity_level::still);
  zassert_equal(classify_second(8), activity_level::still);     // About 31 mg deviation.
  zassert_equal(classify_second(60), activity_level::walking);  // About 117 mg.
  zassert_equal(classify_second(150), activity_level::walking); // About 293 mg.
  zassert_equal(classify_second(200), activity_level::running); // About 390 mg.
}

ZTEST(accel, test_activity_ignores_gravity_and_reports_every_second) {
  activity_classifier classifier;
  std::array<accel_sample, 30> tilted{};
  tilted.fill({256, 0, 0}); // Any constant orientation is still.
  int reports = 0;
  for(int i = 0; i != 20; ++i) {
    if(auto level = classifier.update(tilted)) {
      zassert_equal(*level, activity_level::still);
      ++reports;
    }
  }
  zassert_equal(reports, 6); // 600 samples.
}

ZTEST(accel, test_pack_refuses_a_buffer_that_is_too_small) {
  std::array<accel_sample, 2> samples{};
  std::array<std::uint8_t, accel_header_size + 2 * accel_sample_size - 1> small{};
  small.fill(0xaa);
  zassert_equal(pack_accel(1, 100, samples, small), 0);
  zassert_equal(small[0], 0xaa, "nothing written");
}

ZTEST(accel, test_fifo_status_decoding) {
  zassert_equal(fifo_entries(0x9f), 0x1f);
  zassert_false(fifo_overflowed(0x1f));
  zassert_true(fifo_overflowed(0x20));
}

ZTEST(accel, test_fifo_watchdog_recovers_after_a_second_and_gives_up_on_the_third) {
  fifo_watchdog dog;
  using verdict = fifo_watchdog::verdict;
  for(int i = 0; i != 4; ++i) {
    zassert_equal(dog.poll(false, 200), verdict::ok);
  }
  zassert_equal(dog.poll(false, 200), verdict::recover);
  zassert_equal(dog.poll(true, 200), verdict::ok); // A healthy poll clears the history.
  for(int round = 0; round != 2; ++round) {
    zassert_equal(dog.poll(false, 1000), verdict::recover);
  }
  zassert_equal(dog.poll(false, 1000), verdict::lost);
  zassert_equal(dog.poll(false, 1000), verdict::recover, "lost is reported once");
}

ZTEST(accel, test_activity_thresholds_are_80_and_300_mg) {
  // Swings of 40 and 42 counts alternate magnitudes 156 and 164 mg apart: deviations 78 and 82 mg; 153 and 154 counts: 298.5 and 300.5 mg.
  zassert_equal(classify_second(40), activity_level::still);
  zassert_equal(classify_second(42), activity_level::walking);
  zassert_equal(classify_second(153), activity_level::walking);
  zassert_equal(classify_second(154), activity_level::running);
}

ZTEST(accel, test_activity_window_may_span_chunks_of_any_size) {
  activity_classifier classifier;
  std::array<accel_sample, 30> chunk{};
  int reports = 0;
  std::optional<activity_level> last;
  for(int i = 0; i != 7; ++i) { // 210 samples: windows complete inside chunks 4 and 7.
    for(std::size_t j = 0; j != chunk.size(); ++j) {
      chunk[j] = {0, 0, static_cast<std::int16_t>(256 + ((i * chunk.size() + j) % 2 == 0 ? 0 : 200))};
    }
    if(auto level = classifier.update(chunk)) {
      last = level;
      ++reports;
    }
  }
  zassert_equal(reports, 2);
  zassert_equal(*last, activity_level::running);
}
```

## src/test_battery.cpp
```c
#include "battery.hpp"

#include <zephyr/ztest.h>

#include <initializer_list>

using namespace gtfog;

ZTEST_SUITE(battery, nullptr, nullptr, nullptr, nullptr, nullptr);

ZTEST(battery, test_percentage_is_clamped_and_monotonic) {
  zassert_equal(battery_percentage(2800), 0);
  zassert_equal(battery_percentage(3300), 0);
  zassert_equal(battery_percentage(4200), 100);
  zassert_equal(battery_percentage(4500), 100);

  unsigned previous = 0;
  for(int mv = 3300; mv <= 4200; mv += 10) {
    unsigned p = battery_percentage(mv);
    zassert_true(p >= previous, "%d mV gives %u %% after %u %%", mv, p, previous);
    previous = p;
  }
}

ZTEST(battery, test_percentage_interpolates) {
  zassert_equal(battery_percentage(3750), 40); // Halfway between 3700 mV (30 %) and 3800 mV (50 %).
}

ZTEST(battery, test_charger_states) {
  zassert_equal(decode_charger_state(true, true), charger_state::not_charging);
  zassert_equal(decode_charger_state(true, false), charger_state::charging);
  zassert_equal(decode_charger_state(false, true), charger_state::fault);
  zassert_equal(decode_charger_state(false, false), charger_state::fault);
}

ZTEST(battery, test_guard_needs_consecutive_low_samples) {
  battery_guard guard;
  battery_status low{3200, charger_state::not_charging};
  battery_status ok{3700, charger_state::not_charging};

  zassert_false(guard.update(low));
  zassert_false(guard.update(low));
  zassert_false(guard.update(ok)); // A good sample restarts the count.
  zassert_false(guard.update(low));
  zassert_false(guard.update(low));
  zassert_true(guard.update(low));
}

ZTEST(battery, test_guard_ignores_low_voltage_while_charging) {
  battery_guard guard;
  for(int i = 0; i != 10; ++i) {
    zassert_false(guard.update({3000, charger_state::charging}));
  }
}

ZTEST(battery, test_guard_cutoff_boundary_and_charging_sample_in_between) {
  battery_guard guard;
  battery_status edge{battery_guard::cutoff_millivolts, charger_state::not_charging};
  for(int i = 0; i != 5; ++i) {
    zassert_false(guard.update(edge), "exactly the cutoff is not below it");
  }
  battery_status low{battery_guard::cutoff_millivolts - 1, charger_state::not_charging};
  zassert_false(guard.update(low));
  zassert_false(guard.update(low));
  zassert_false(guard.update({3000, charger_state::charging})); // Restarts the count.
  zassert_false(guard.update(low));
  zassert_false(guard.update(low));
  zassert_true(guard.update(low));
}

ZTEST(battery, test_start_needs_a_margin_above_the_cutoff) {
  zassert_false(battery_allows_start({3399, charger_state::not_charging}));
  zassert_true(battery_allows_start({3400, charger_state::not_charging}));
  zassert_true(battery_allows_start({3000, charger_state::charging}));
  zassert_false(battery_allows_start({3000, charger_state::fault}));
}

ZTEST(battery, test_percentage_at_every_knot_of_the_curve) {
  struct knot {
    int millivolts;
    unsigned percent;
  };
  for(auto k : {knot{3300, 0}, knot{3500, 5}, knot{3600, 10}, knot{3700, 30}, knot{3800, 50}, knot{3900, 65}, knot{4000, 80}, knot{4200, 100}}) {
    zassert_equal(battery_percentage(k.millivolts), k.percent, "%d mV", k.millivolts);
  }
}
```

## src/test_battery_model.cpp
```c
#include "battery_model.hpp"

#include <zephyr/ztest.h>

#include <initializer_list>
#include <tuple>

using namespace gtfog;

ZTEST_SUITE(battery_model, nullptr, nullptr, nullptr, nullptr, nullptr);

ZTEST(battery_model, test_percentage_is_clamped_and_monotonic) {
  zassert_equal(battery_percentage(2800), 0);
  zassert_equal(battery_percentage(3300), 0);
  zassert_equal(battery_percentage(4200), 100);
  zassert_equal(battery_percentage(4500), 100);

  unsigned previous = 0;
  for(int mv = 3300; mv <= 4200; mv += 10) {
    unsigned p = battery_percentage(mv);
    zassert_true(p >= previous, "%d mV gives %u %% after %u %%", mv, p, previous);
    previous = p;
  }
}

ZTEST(battery_model, test_percentage_interpolates) {
  zassert_equal(battery_percentage(3750), 40); // Halfway between 3700 mV (30 %) and 3800 mV (50 %).
}

ZTEST(battery_model, test_level_filter_adds_back_the_fan_drop_and_smooths) {
  battery_level_filter filter;
  zassert_equal(filter.update(4200, 0), 100);
  // The fan starts: the reading drops by the fan's share, which is added back.
  zassert_equal(filter.update(4200 - battery_level_filter::fan_drop_millivolts, 100), 100);
  // A single low sample moves the level only 1/smoothing of the way.
  battery_level_filter noisy;
  zassert_equal(noisy.update(3900, 0), 65);
  zassert_equal(noisy.update(3500, 0), battery_percentage(3900 - 400 / battery_level_filter::smoothing));
  for(int i = 0; i != 80; ++i) {
    std::ignore = noisy.update(3500, 0);
  }
  zassert_equal(noisy.update(3500, 0), battery_percentage(3500), "a lasting drop is followed");
}

ZTEST(battery_model, test_charger_states) {
  zassert_equal(decode_charger_state(true, true), charger_state::not_charging);
  zassert_equal(decode_charger_state(true, false), charger_state::charging);
  zassert_equal(decode_charger_state(false, true), charger_state::fault);
  zassert_equal(decode_charger_state(false, false), charger_state::fault);
}

ZTEST(battery_model, test_guard_needs_consecutive_low_samples) {
  battery_guard guard;
  battery_status low{3200, charger_state::not_charging};
  battery_status ok{3700, charger_state::not_charging};

  zassert_false(guard.update(low));
  zassert_false(guard.update(low));
  zassert_false(guard.update(ok)); // A good sample restarts the count.
  zassert_false(guard.update(low));
  zassert_false(guard.update(low));
  zassert_true(guard.update(low));
}

ZTEST(battery_model, test_guard_ignores_low_voltage_while_charging) {
  battery_guard guard;
  for(int i = 0; i != 10; ++i) {
    zassert_false(guard.update({3000, charger_state::charging}));
  }
}

ZTEST(battery_model, test_guard_cutoff_boundary_and_charging_sample_in_between) {
  battery_guard guard;
  battery_status edge{battery_guard::cutoff_millivolts, charger_state::not_charging};
  for(int i = 0; i != 5; ++i) {
    zassert_false(guard.update(edge), "exactly the cutoff is not below it");
  }
  battery_status low{battery_guard::cutoff_millivolts - 1, charger_state::not_charging};
  zassert_false(guard.update(low));
  zassert_false(guard.update(low));
  zassert_false(guard.update({3000, charger_state::charging})); // Restarts the count.
  zassert_false(guard.update(low));
  zassert_false(guard.update(low));
  zassert_true(guard.update(low));
}

ZTEST(battery_model, test_start_needs_a_margin_above_the_cutoff) {
  zassert_false(battery_allows_start({3399, charger_state::not_charging}));
  zassert_true(battery_allows_start({3400, charger_state::not_charging}));
  zassert_true(battery_allows_start({3000, charger_state::charging}));
  zassert_false(battery_allows_start({3000, charger_state::fault}));
}

ZTEST(battery_model, test_percentage_at_every_knot_of_the_curve) {
  struct knot {
    int millivolts;
    unsigned percent;
  };
  for(auto k : {knot{3300, 0}, knot{3500, 5}, knot{3600, 10}, knot{3700, 30}, knot{3800, 50}, knot{3900, 65}, knot{4000, 80}, knot{4200, 100}}) {
    zassert_equal(battery_percentage(k.millivolts), k.percent, "%d mV", k.millivolts);
  }
}

ZTEST(battery_model, test_read_failures_show_a_fault_once_then_power_off_once) {
  using verdict = read_failure_guard::verdict;
  read_failure_guard guard;
  for(unsigned i = 1; i < read_failure_guard::fault_reads; ++i) {
    zassert_equal(guard.update(false), verdict::ok);
  }
  zassert_equal(guard.update(false), verdict::fault);
  for(unsigned i = read_failure_guard::fault_reads + 1; i < read_failure_guard::power_off_reads; ++i) {
    zassert_equal(guard.update(false), verdict::ok);
  }
  zassert_equal(guard.update(false), verdict::power_off);
  zassert_equal(guard.update(false), verdict::ok, "reported once");
  zassert_equal(guard.update(true), verdict::ok);
  zassert_equal(guard.update(false), verdict::ok);
  zassert_equal(guard.update(false), verdict::ok);
  zassert_equal(guard.update(false), verdict::fault, "a good read rearms it");
}
```

## src/test_buttons.cpp
```c
#include "buttons.hpp"

#include <zephyr/ztest.h>

#include <optional>
#include <vector>

using namespace gtfog;
using namespace std::chrono_literals;

namespace {

// Drives the detector like the firmware does: a sample every 20 ms between `from` and `to`.
auto run(button_gestures &g, bool plus, bool minus, std::chrono::milliseconds from, std::chrono::milliseconds to) -> std::vector<button_event> {
  std::vector<button_event> events;
  for(auto t = from; t <= to; t += 20ms) {
    if(auto e = g.update(plus, minus, t)) {
      events.push_back(*e);
    }
  }
  return events;
}

} // namespace

ZTEST_SUITE(buttons, nullptr, nullptr, nullptr, nullptr, nullptr);

ZTEST(buttons, test_short_press_fires_on_release) {
  button_gestures g;
  zassert_true(run(g, true, false, 0ms, 100ms).empty());
  auto released = g.update(false, false, 120ms);
  zassert_true((released == button_event{button_action::plus, 1}));
  zassert_true(g.is_idle());
}

ZTEST(buttons, test_bounce_is_ignored) {
  button_gestures g;
  zassert_false(g.update(false, true, 0ms).has_value());
  zassert_false(g.update(false, false, 20ms).has_value());
}

ZTEST(buttons, test_long_press_repeats_and_accelerates) {
  button_gestures g;
  auto events = run(g, false, true, 0ms, 7000ms);
  zassert_false(events.empty());
  zassert_true((events.front() == button_event{button_action::minus, 1}));
  zassert_true((events.back() == button_event{button_action::minus, 3, true})); // 6..9 s of holding.
  // One repeat per 200 ms from 500 ms on.
  zassert_within(events.size(), (7000 - 500) / 200, 2);
  zassert_false(g.update(false, false, 7020ms).has_value(), "a long press must not also fire on release");
}

ZTEST(buttons, test_steps_are_capped) {
  button_gestures g;
  auto events = run(g, true, false, 0ms, 20s);
  zassert_equal(events.back().steps, button_timing{}.max_steps);
}

ZTEST(buttons, test_stuck_button_goes_quiet) {
  button_gestures g;
  std::ignore = run(g, true, false, 0ms, 30s);
  zassert_true(run(g, true, false, 30020ms, 40s).empty());
}

ZTEST(buttons, test_chord_released_between_2_and_5_s_toggles_strobe) {
  button_gestures g;
  zassert_true(run(g, true, true, 0ms, 3s).empty());
  auto released = g.update(false, false, 3020ms);
  zassert_true((released == button_event{button_action::toggle_strobe}));
  zassert_false(g.update(false, false, 3040ms).has_value());
}

ZTEST(buttons, test_chord_toggles_strobe_when_one_button_is_let_go) {
  button_gestures g;
  std::ignore = run(g, true, true, 0ms, 2500ms);
  auto released = g.update(true, false, 2520ms);
  zassert_true((released == button_event{button_action::toggle_strobe}));
  zassert_true(run(g, true, false, 2540ms, 4000ms).empty(), "the button still held must not repeat");
  zassert_false(g.update(false, false, 4020ms).has_value());
  zassert_true(g.is_idle());
}

ZTEST(buttons, test_chord_held_to_5_s_powers_off_without_strobe) {
  button_gestures g;
  auto events = run(g, true, true, 0ms, 6s);
  zassert_equal(events.size(), 1);
  zassert_true((events[0] == button_event{button_action::power_off}));
  zassert_false(g.update(false, false, 6020ms).has_value());
}

ZTEST(buttons, test_chord_released_before_2_s_fires_nothing) {
  button_gestures g;
  std::ignore = run(g, true, true, 0ms, 1000ms);
  zassert_false(g.update(true, false, 1020ms).has_value());
  zassert_true(run(g, true, true, 1040ms, 6s).empty());
}

// Presses plus for 100 ms starting at `at`.
auto tap(button_gestures &g, std::chrono::milliseconds at) -> std::optional<button_event> {
  std::ignore = g.update(true, false, at);
  std::ignore = g.update(true, false, at + 60ms);
  return g.update(false, false, at + 100ms);
}

ZTEST(buttons, test_third_quick_plus_press_unlocks) {
  button_gestures g;
  zassert_true((tap(g, 0ms) == button_event{button_action::plus}));
  zassert_true((tap(g, 400ms) == button_event{button_action::plus}));
  zassert_true((tap(g, 800ms) == button_event{button_action::unlock}));
  zassert_true((tap(g, 1200ms) == button_event{button_action::plus}), "the count starts over");
}

ZTEST(buttons, test_slow_plus_presses_do_not_unlock) {
  button_gestures g;
  for(auto at = 0ms; at < 6s; at += 1500ms) {
    zassert_true((tap(g, at) == button_event{button_action::plus}));
  }
}

ZTEST(buttons, test_long_press_does_not_count_for_unlock) {
  button_gestures g;
  zassert_true((tap(g, 0ms) == button_event{button_action::plus}));
  zassert_true(run(g, true, false, 400ms, 1000ms).size() > 0);
  std::ignore = g.update(false, false, 1020ms);
  zassert_true((tap(g, 1200ms) == button_event{button_action::plus}));
}

ZTEST(buttons, test_release_between_long_press_and_first_repeat_is_one_step) {
  button_gestures g;
  std::ignore = g.update(true, false, 0ms);
  zassert_false(g.update(true, false, 490ms).has_value());
  zassert_true((g.update(false, false, 505ms) == button_event{button_action::plus, 1}));
  zassert_false(g.update(false, false, 520ms).has_value());
  // After a repeat has fired, the release adds nothing.
  button_gestures h;
  auto events = run(h, false, true, 0ms, 520ms);
  zassert_equal(events.size(), 1);
  zassert_false(h.update(false, false, 530ms).has_value());
}

ZTEST(buttons, test_press_held_since_boot_is_ignored_until_released) {
  button_gestures g;
  g.wait_for_release();
  zassert_true(run(g, true, false, 0ms, 3s).empty());
  zassert_false(g.update(false, false, 3020ms).has_value(), "the release is no short press");
  zassert_true((tap(g, 4s) == button_event{button_action::plus}));
}

ZTEST(buttons, test_stuck_button_lets_the_thread_sleep) {
  button_gestures g;
  std::ignore = run(g, true, false, 0ms, 29s);
  zassert_false(g.is_idle());
  std::ignore = run(g, true, false, 29020ms, 30100ms);
  zassert_true(g.is_idle());
  zassert_false(g.update(false, false, 40s).has_value());
}

ZTEST(buttons, test_stuck_button_then_chord_still_powers_off) {
  button_gestures g;
  std::ignore = run(g, true, false, 0ms, 31s);
  zassert_true(g.is_idle());
  auto events = run(g, true, true, 31020ms, 37s);
  zassert_equal(events.size(), 1);
  zassert_true((events[0] == button_event{button_action::power_off}));
}

ZTEST(buttons, test_second_button_during_repeat_starts_a_chord_and_stops_the_repeat) {
  button_gestures g;
  zassert_false(run(g, true, false, 0ms, 1000ms).empty());
  zassert_true(run(g, true, true, 1020ms, 3200ms).empty());
  auto released = g.update(false, false, 3220ms);
  zassert_true((released == button_event{button_action::toggle_strobe}));
}

ZTEST(buttons, test_both_held_since_boot_still_power_off) {
  button_gestures g;
  g.wait_for_release();
  auto events = run(g, true, true, 0ms, 6s);
  zassert_equal(events.size(), 1);
  zassert_true((events[0] == button_event{button_action::power_off}));
}

ZTEST(buttons, test_second_button_after_a_boot_press_starts_the_chord) {
  button_gestures g;
  g.wait_for_release();
  zassert_true(run(g, true, false, 0ms, 1s).empty());
  auto events = run(g, true, true, 1020ms, 7s);
  zassert_equal(events.size(), 1);
  zassert_true((events[0] == button_event{button_action::power_off}));
}

ZTEST(buttons, test_only_repeats_after_the_first_are_marked) {
  button_gestures g;
  auto events = run(g, true, false, 0ms, 2s);
  zassert_true(events.size() > 3);
  zassert_false(events.front().repeat);
  for(std::size_t i = 1; i != events.size(); ++i) {
    zassert_true(events[i].repeat);
  }
}
```

## src/test_controller_machine.cpp
```c
#include "controller.hpp"
#include "fake_outputs.hpp"

#include <zephyr/ztest.h>

#include <algorithm>
#include <vector>

using namespace gtfog;
using namespace std::chrono_literals;

namespace {

auto press(button_action action, unsigned steps = 1) -> button_event { return {action, steps}; }

} // namespace

ZTEST_SUITE(controller_machine, nullptr, nullptr, nullptr, nullptr, nullptr);

ZTEST(controller_machine, test_initial_states) {
  fake_outputs out;
  controller c{out};
  zassert_true(c.is(states::running));
  zassert_false(c.settings().transport_lock);
  zassert_equal(c.settings().mode, fan_mode::manual);
}

// The lock and mode are written once, in the settings: what comes out is what went in, whichever way it was written.
ZTEST(controller_machine, test_settings_round_trip_through_the_machine_and_the_codec) {
  for(bool lock_a : {false, true}) {
    for(auto mode_a : {fan_mode::manual, fan_mode::motion}) {
      for(bool lock_b : {false, true}) {
        for(auto mode_b : {fan_mode::manual, fan_mode::motion}) {
          fake_outputs out;
          controller c{out};
          device_settings loaded{.transport_lock = lock_a, .mode = mode_a};
          device_settings written{.transport_lock = lock_b, .mode = mode_b};
          c.configure(loaded); // Flash load at boot.
          zassert_true(c.settings() == loaded);
          c.update_settings(written); // Bluetooth.
          zassert_true(c.settings() == written);
          auto bytes = encode(c.settings());
          auto decoded = decode_settings(bytes);
          zassert_true(decoded.has_value() && *decoded == written);
          c.configure(loaded);
          c.handle(press(button_action::unlock));
          zassert_false(c.settings().transport_lock);
        }
      }
    }
  }
}

ZTEST(controller_machine, test_lock_blocks_fan_and_strobe_in_manual_mode_and_unlock_restores) {
  fake_outputs out;
  controller c{out};
  c.power_on();
  c.handle(press(button_action::plus, 4)); // 20 %
  c.set_strobe(true);
  zassert_equal(out.fan, 20);
  zassert_true(out.strobe);

  c.update_settings({.transport_lock = true});
  zassert_true(c.settings().transport_lock);
  zassert_equal(out.fan, 0);
  zassert_false(out.strobe);
  c.handle(press(button_action::plus));
  c.handle(press(button_action::minus));
  c.handle(press(button_action::toggle_strobe));
  zassert_equal(out.fan, 0);
  zassert_false(out.strobe);

  c.handle(press(button_action::unlock));
  zassert_false(c.settings().transport_lock);
  zassert_equal(out.fan, 20, "the targets were kept");
  zassert_true(out.strobe);
  zassert_equal(out.signals.back(), signal::unlocked);
  zassert_false(c.settings().transport_lock);
}

ZTEST(controller_machine, test_lock_blocks_fan_and_strobe_in_motion_mode_and_unlock_restores) {
  fake_outputs out;
  controller c{out};
  c.update_settings({.mode = fan_mode::motion, .motion_speed = {30, 50, 80}});
  c.power_on();
  c.set_strobe(true);
  zassert_equal(out.fan, 30);

  c.update_settings({.transport_lock = true, .mode = fan_mode::motion, .motion_speed = {30, 50, 80}});
  zassert_true(c.settings().transport_lock);
  zassert_equal(c.settings().mode, fan_mode::motion);
  c.observe(activity_level::running);
  c.observe(activity_level::running);
  c.handle(press(button_action::plus));
  c.handle(press(button_action::toggle_strobe));
  zassert_equal(out.fan, 0);
  zassert_false(out.strobe);

  c.handle(press(button_action::unlock));
  zassert_false(c.settings().transport_lock);
  zassert_equal(c.settings().mode, fan_mode::motion);
  zassert_equal(out.fan, 30, "the accelerometer was off under the lock, so the level starts again at still");
  zassert_true(out.strobe);
}

ZTEST(controller_machine, test_locked_buttons_signal_once_and_do_not_save) {
  fake_outputs out;
  controller c{out};
  c.configure({.transport_lock = true});
  c.power_on();
  out.signals.clear();
  c.handle(button_event{button_action::minus, 1, false});
  c.handle(button_event{button_action::minus, 1, true});
  c.handle(button_event{button_action::toggle_strobe, 1, false});
  zassert_true((out.signals == std::vector{signal::locked, signal::locked}));
  zassert_equal(out.saved_count(), 0);
}

ZTEST(controller_machine, test_power_off_from_every_lock_and_mode_state) {
  for(bool lock : {false, true}) {
    for(auto mode : {fan_mode::manual, fan_mode::motion}) {
      fake_outputs out;
      controller c{out};
      c.configure({.transport_lock = lock, .mode = mode});
      c.power_on();
      c.set_strobe(true);
      c.handle(press(button_action::power_off));
      zassert_true(c.is(states::powered_off));
      zassert_true(out.powered_off);
      zassert_equal(out.fan, 0);
      zassert_false(out.strobe);
      zassert_equal(out.signals.back(), signal::power_off);
    }
  }
}

ZTEST(controller_machine, test_power_off_by_battery_and_auto_off) {
  fake_outputs low;
  controller c{low};
  c.check_start({3000, charger_state::not_charging});
  zassert_true(c.is(states::powered_off));
  zassert_equal(low.signals.back(), signal::low_battery);

  fake_outputs idle;
  controller d{idle};
  d.configure({.auto_off_minutes = 1});
  d.elapsed(61s, false);
  zassert_true(d.is(states::powered_off));
}

ZTEST(controller_machine, test_powered_off_ignores_further_requests) {
  fake_outputs out;
  controller c{out};
  c.handle(press(button_action::power_off));
  out.signals.clear();
  c.set_fan_speed(50);
  c.set_strobe(true);
  c.report(signal::fault);
  zassert_true(c.is(states::powered_off));
  zassert_equal(out.fan, 0);
  zassert_false(out.strobe);
  zassert_true(out.signals.empty());
}

ZTEST(controller_machine, test_motion_and_manual_switching) {
  fake_outputs out;
  controller c{out};
  c.update_settings({.mode = fan_mode::motion, .motion_delay_s = 10, .motion_speed = {20, 50, 80}});
  c.power_on();
  c.observe(activity_level::walking);
  c.observe(activity_level::walking);
  zassert_equal(c.settings().mode, fan_mode::motion);
  zassert_equal(out.fan, 50);
  zassert_equal(c.activity_code(), 1);

  c.update_settings({.mode = fan_mode::manual, .motion_speed = {20, 50, 80}});
  zassert_equal(c.settings().mode, fan_mode::manual);
  zassert_equal(c.activity_code(), 255);
  zassert_equal(out.fan, 0, "the manual target is untouched");
  c.observe(activity_level::running); // Ignored in manual mode.
  c.observe(activity_level::running);
  zassert_equal(out.fan, 0);

  c.update_settings({.mode = fan_mode::motion, .motion_speed = {20, 50, 80}});
  zassert_equal(c.settings().mode, fan_mode::motion);
  zassert_equal(c.activity_code(), 0, "back to still");
  zassert_equal(out.fan, 20);
}

ZTEST(controller_machine, test_sensor_lost_in_motion_mode_runs_at_the_still_speed) {
  fake_outputs out;
  controller c{out};
  c.update_settings({.mode = fan_mode::motion, .motion_speed = {20, 50, 80}});
  c.observe(activity_level::running);
  c.observe(activity_level::running);
  zassert_equal(out.fan, 80);
  c.sensor_lost();
  zassert_equal(out.fan, 20);
  zassert_equal(out.signals.back(), signal::fault);
  zassert_true(c.is(states::running));
}

ZTEST(controller_machine, test_battery_warning_once_until_the_cell_recovers) {
  fake_outputs out;
  controller c{out};
  auto count = [&] { return std::count(out.signals.begin(), out.signals.end(), signal::battery_warning); };
  auto sample = [&](int millivolts) {
    for(int i = 0; i != 40; ++i) { // Until the averaged level settles (the warning needs 3 samples in a row).
      c.handle(battery_status{millivolts, charger_state::not_charging});
    }
  };
  sample(3500); // 5 %.
  zassert_equal(count(), 1);
  sample(3700); // 30 %: recovered.
  sample(3500);
  zassert_equal(count(), 2);
  zassert_true(c.is(states::running));
}

ZTEST(controller_machine, test_activity_level_restarts_when_the_lock_flips_by_gesture_or_bluetooth) {
  for(bool by_gesture : {true, false}) {
    fake_outputs out;
    controller c{out};
    c.update_settings({.mode = fan_mode::motion, .motion_speed = {30, 50, 80}});
    c.power_on();
    c.observe(activity_level::running);
    c.observe(activity_level::running);
    zassert_equal(out.fan, 80);
    c.update_settings({.transport_lock = true, .mode = fan_mode::motion, .motion_speed = {30, 50, 80}});
    zassert_equal(out.fan, 0);
    if(by_gesture) {
      c.handle(press(button_action::unlock));
    } else {
      c.update_settings({.mode = fan_mode::motion, .motion_speed = {30, 50, 80}});
    }
    zassert_equal(out.fan, 30);
    zassert_equal(c.activity_code(), 0);
  }
}

ZTEST(controller_machine, test_unreadable_battery_powers_off) {
  fake_outputs out;
  controller c{out};
  c.power_on();
  c.battery_unreadable();
  zassert_true(c.is(states::powered_off));
  zassert_true(out.powered_off);
  zassert_equal(out.signals.back(), signal::low_battery);
}

// The lock and mode regions hold the truth; every way in leads to the matching state.
ZTEST(controller_machine, test_lock_and_mode_states_follow_flash_load_bluetooth_and_the_unlock_gesture) {
  fake_outputs out;
  controller c{out};
  zassert_true(c.is(states::unlocked) && c.is(states::manual));

  c.configure({.transport_lock = true, .mode = fan_mode::motion}); // Flash load: states change, nothing is shown or saved.
  zassert_true(c.is(states::locked) && c.is(states::motion));
  zassert_equal(out.saved_count(), 0);
  zassert_true(out.signals.empty());

  c.handle(press(button_action::unlock));
  zassert_true(c.is(states::unlocked) && c.is(states::motion));
  zassert_equal(out.saved_count(), 1);
  zassert_equal(out.signals.back(), signal::unlocked);

  c.update_settings({.transport_lock = true, .mode = fan_mode::manual}); // Bluetooth.
  zassert_true(c.is(states::locked) && c.is(states::manual));
  zassert_equal(out.saved_count(), 2);
  c.update_settings({.stealth = true, .transport_lock = true}); // Same states: stay.
  zassert_true(c.is(states::locked) && c.is(states::manual));
  c.update_settings({});
  zassert_true(c.is(states::unlocked) && c.is(states::manual));
  zassert_equal(out.saved_count(), 4);
}

ZTEST(controller_machine, test_encoded_flags_come_from_the_states) {
  fake_outputs out;
  controller c{out};
  c.update_settings({.transport_lock = true, .mode = fan_mode::motion});
  auto bytes = encode(c.settings());
  zassert_equal(bytes[0] & 2U, 2U);
  zassert_equal(bytes[3], 1);
  c.handle(press(button_action::unlock)); // Only the state changes; the flag follows it.
  zassert_true(c.is(states::unlocked));
  bytes = encode(c.settings());
  zassert_equal(bytes[0] & 2U, 0U);
  zassert_equal(bytes[3], 1);
}
```

## src/test_gestures.cpp
```c
#include "gestures.hpp"

#include <zephyr/ztest.h>

#include <optional>
#include <vector>

using namespace gtfog;
using namespace std::chrono_literals;

namespace {

// Drives the detector like the firmware does: a sample every 20 ms between `from` and `to`.
auto run(button_gestures &g, bool plus, bool minus, std::chrono::milliseconds from, std::chrono::milliseconds to) -> std::vector<button_event> {
  std::vector<button_event> events;
  for(auto t = from; t <= to; t += 20ms) {
    if(auto e = g.update(plus, minus, t)) {
      events.push_back(*e);
    }
  }
  return events;
}

} // namespace

ZTEST_SUITE(gestures, nullptr, nullptr, nullptr, nullptr, nullptr);

ZTEST(gestures, test_short_press_fires_on_release) {
  button_gestures g;
  zassert_true(run(g, true, false, 0ms, 100ms).empty());
  auto released = g.update(false, false, 120ms);
  zassert_true((released == button_event{button_action::plus, 1}));
  zassert_true(g.is_idle());
}

ZTEST(gestures, test_bounce_is_ignored) {
  button_gestures g;
  zassert_false(g.update(false, true, 0ms).has_value());
  zassert_false(g.update(false, false, 20ms).has_value());
}

ZTEST(gestures, test_long_press_repeats_and_accelerates) {
  button_gestures g;
  auto events = run(g, false, true, 0ms, 7000ms);
  zassert_false(events.empty());
  zassert_true((events.front() == button_event{button_action::minus, 1}));
  zassert_true((events.back() == button_event{button_action::minus, 3, true})); // 6..9 s of holding.
  // One repeat per 200 ms from 500 ms on.
  zassert_within(events.size(), (7000 - 500) / 200, 2);
  zassert_false(g.update(false, false, 7020ms).has_value(), "a long press must not also fire on release");
}

ZTEST(gestures, test_steps_are_capped) {
  button_gestures g;
  auto events = run(g, true, false, 0ms, 20s);
  zassert_equal(events.back().steps, button_timing{}.max_steps);
}

ZTEST(gestures, test_stuck_button_goes_quiet) {
  button_gestures g;
  std::ignore = run(g, true, false, 0ms, 30s);
  zassert_true(run(g, true, false, 30020ms, 40s).empty());
}

ZTEST(gestures, test_chord_released_between_2_and_5_s_toggles_strobe) {
  button_gestures g;
  zassert_true(run(g, true, true, 0ms, 3s).empty());
  auto released = g.update(false, false, 3020ms);
  zassert_true((released == button_event{button_action::toggle_strobe}));
  zassert_false(g.update(false, false, 3040ms).has_value());
}

ZTEST(gestures, test_chord_toggles_strobe_when_one_button_is_let_go) {
  button_gestures g;
  std::ignore = run(g, true, true, 0ms, 2500ms);
  auto released = g.update(true, false, 2520ms);
  zassert_true((released == button_event{button_action::toggle_strobe}));
  zassert_true(run(g, true, false, 2540ms, 4000ms).empty(), "the button still held must not repeat");
  zassert_false(g.update(false, false, 4020ms).has_value());
  zassert_true(g.is_idle());
}

ZTEST(gestures, test_chord_held_to_5_s_powers_off_without_strobe) {
  button_gestures g;
  auto events = run(g, true, true, 0ms, 6s);
  zassert_equal(events.size(), 1);
  zassert_true((events[0] == button_event{button_action::power_off}));
  zassert_false(g.update(false, false, 6020ms).has_value());
}

ZTEST(gestures, test_chord_released_before_2_s_fires_nothing) {
  button_gestures g;
  std::ignore = run(g, true, true, 0ms, 1000ms);
  zassert_false(g.update(true, false, 1020ms).has_value());
  zassert_true(run(g, true, true, 1040ms, 6s).empty());
}

// Presses plus for 100 ms starting at `at`.
auto tap(button_gestures &g, std::chrono::milliseconds at) -> std::optional<button_event> {
  std::ignore = g.update(true, false, at);
  std::ignore = g.update(true, false, at + 60ms);
  return g.update(false, false, at + 100ms);
}

ZTEST(gestures, test_third_quick_plus_press_unlocks) {
  button_gestures g;
  zassert_true((tap(g, 0ms) == button_event{button_action::plus}));
  zassert_true((tap(g, 400ms) == button_event{button_action::plus}));
  zassert_true((tap(g, 800ms) == button_event{button_action::unlock}));
  zassert_true((tap(g, 1200ms) == button_event{button_action::plus}), "the count starts over");
}

ZTEST(gestures, test_minus_tap_resets_the_unlock_count) {
  button_gestures g;
  zassert_true((tap(g, 0ms) == button_event{button_action::plus}));
  zassert_true((tap(g, 300ms) == button_event{button_action::plus}));
  std::ignore = g.update(false, true, 600ms);
  std::ignore = g.update(false, true, 660ms);
  zassert_true((g.update(false, false, 700ms) == button_event{button_action::minus}));
  zassert_true((tap(g, 900ms) == button_event{button_action::plus}), "the third plus tap would have unlocked");
  zassert_true((tap(g, 1200ms) == button_event{button_action::plus}));
  zassert_true((tap(g, 1500ms) == button_event{button_action::unlock}), "three plus taps after the minus tap unlock");
}

ZTEST(gestures, test_slow_plus_presses_do_not_unlock) {
  button_gestures g;
  for(auto at = 0ms; at < 6s; at += 1500ms) {
    zassert_true((tap(g, at) == button_event{button_action::plus}));
  }
}

ZTEST(gestures, test_long_press_does_not_count_for_unlock) {
  button_gestures g;
  zassert_true((tap(g, 0ms) == button_event{button_action::plus}));
  zassert_true(run(g, true, false, 400ms, 1000ms).size() > 0);
  std::ignore = g.update(false, false, 1020ms);
  zassert_true((tap(g, 1200ms) == button_event{button_action::plus}));
}

ZTEST(gestures, test_release_between_long_press_and_first_repeat_is_one_step) {
  button_gestures g;
  std::ignore = g.update(true, false, 0ms);
  zassert_false(g.update(true, false, 490ms).has_value());
  zassert_true((g.update(false, false, 505ms) == button_event{button_action::plus, 1}));
  zassert_false(g.update(false, false, 520ms).has_value());
  // After a repeat has fired, the release adds nothing.
  button_gestures h;
  auto events = run(h, false, true, 0ms, 520ms);
  zassert_equal(events.size(), 1);
  zassert_false(h.update(false, false, 530ms).has_value());
}

ZTEST(gestures, test_press_held_since_boot_is_ignored_until_released) {
  button_gestures g;
  g.wait_for_release();
  zassert_true(run(g, true, false, 0ms, 3s).empty());
  zassert_false(g.update(false, false, 3020ms).has_value(), "the release is no short press");
  zassert_true((tap(g, 4s) == button_event{button_action::plus}));
}

ZTEST(gestures, test_stuck_button_lets_the_thread_sleep) {
  button_gestures g;
  std::ignore = run(g, true, false, 0ms, 29s);
  zassert_false(g.is_idle());
  std::ignore = run(g, true, false, 29020ms, 30100ms);
  zassert_true(g.is_idle());
  zassert_false(g.update(false, false, 40s).has_value());
}

ZTEST(gestures, test_stuck_button_then_chord_still_powers_off) {
  button_gestures g;
  std::ignore = run(g, true, false, 0ms, 31s);
  zassert_true(g.is_idle());
  auto events = run(g, true, true, 31020ms, 37s);
  zassert_equal(events.size(), 1);
  zassert_true((events[0] == button_event{button_action::power_off}));
}

ZTEST(gestures, test_second_button_during_repeat_starts_a_chord_and_stops_the_repeat) {
  button_gestures g;
  zassert_false(run(g, true, false, 0ms, 1000ms).empty());
  zassert_true(run(g, true, true, 1020ms, 3200ms).empty());
  auto released = g.update(false, false, 3220ms);
  zassert_true((released == button_event{button_action::toggle_strobe}));
}

ZTEST(gestures, test_both_held_since_boot_still_power_off) {
  button_gestures g;
  g.wait_for_release();
  auto events = run(g, true, true, 0ms, 6s);
  zassert_equal(events.size(), 1);
  zassert_true((events[0] == button_event{button_action::power_off}));
}

ZTEST(gestures, test_second_button_after_a_boot_press_starts_the_chord) {
  button_gestures g;
  g.wait_for_release();
  zassert_true(run(g, true, false, 0ms, 1s).empty());
  auto events = run(g, true, true, 1020ms, 7s);
  zassert_equal(events.size(), 1);
  zassert_true((events[0] == button_event{button_action::power_off}));
}

ZTEST(gestures, test_only_repeats_after_the_first_are_marked) {
  button_gestures g;
  auto events = run(g, true, false, 0ms, 2s);
  zassert_true(events.size() > 3);
  zassert_false(events.front().repeat);
  for(std::size_t i = 1; i != events.size(); ++i) {
    zassert_true(events[i].repeat);
  }
}
```

## src/test_motion.cpp
```c
#include "motion.hpp"

#include <zephyr/ztest.h>

#include <array>
#include <chrono>
#include <optional>

using namespace gtfog;

ZTEST_SUITE(motion, nullptr, nullptr, nullptr, nullptr, nullptr);

ZTEST(motion, test_counts_to_milli_g) {
  zassert_equal(counts_to_milli_g(0), 0);
  zassert_equal(counts_to_milli_g(256), 998); // About 1 g.
  zassert_equal(counts_to_milli_g(-256), -998);
  zassert_equal(counts_to_milli_g(4095), 15970);  // +-16 g full scale fits int16.
  zassert_equal(counts_to_milli_g(32767), 15974); // A corrupt sample is clamped, not wrapped.
  zassert_equal(counts_to_milli_g(-32768), -15974);
}

ZTEST(motion, test_samples_per_packet) {
  zassert_equal(accelerometer_samples_per_packet(23), 2); // Default ATT MTU: 20-byte payload.
  zassert_equal(accelerometer_samples_per_packet(247), 40);
  zassert_equal(accelerometer_samples_per_packet(517), 40);
  zassert_equal(accelerometer_samples_per_packet(5), 0);
}

ZTEST(motion, test_pack_layout) {
  std::array<accelerometer_sample, 2> samples{{{256, -256, 0}, {1, 2, -3}}};
  std::array<std::uint8_t, accelerometer_header_size + 2 * accelerometer_sample_size> out{};
  auto len = pack_accelerometer_samples(0x1234, 100, samples, out);
  zassert_equal(len, out.size());
  zassert_equal(out[0], 0x34);
  zassert_equal(out[1], 0x12);
  zassert_equal(out[2], 100);
  zassert_equal(out[3], 2);
  zassert_equal(static_cast<std::int16_t>(out[4] | out[5] << 8), 998);
  zassert_equal(static_cast<std::int16_t>(out[6] | out[7] << 8), -998);
  zassert_equal(static_cast<std::int16_t>(out[8] | out[9] << 8), 0);
  zassert_equal(static_cast<std::int16_t>(out[14] | out[15] << 8), -11); // -3 counts = -11.7 mg, truncated.
}

namespace {

// One second of samples whose magnitude alternates between 1 g and 1 g + `swing` counts: the deviation is half the swing.
auto classify_second(int swing) -> std::optional<activity_level> {
  activity_classifier classifier;
  std::array<accelerometer_sample, 50> batch{};
  std::optional<activity_level> level;
  for(int half = 0; half != 2; ++half) {
    for(std::size_t i = 0; i != batch.size(); ++i) {
      batch[i] = {0, 0, static_cast<std::int16_t>(256 + (i % 2 == 0 ? 0 : swing))};
    }
    zassert_false(level.has_value(), "a level only after 100 samples");
    level = classifier.update(batch);
  }
  return level;
}

} // namespace

ZTEST(motion, test_activity_levels) {
  zassert_equal(classify_second(0), activity_level::still);
  zassert_equal(classify_second(8), activity_level::still);     // About 31 mg deviation.
  zassert_equal(classify_second(60), activity_level::walking);  // About 117 mg.
  zassert_equal(classify_second(150), activity_level::walking); // About 293 mg.
  zassert_equal(classify_second(200), activity_level::running); // About 390 mg.
}

ZTEST(motion, test_activity_ignores_gravity_and_reports_every_second) {
  activity_classifier classifier;
  std::array<accelerometer_sample, 30> tilted{};
  tilted.fill({256, 0, 0}); // Any constant orientation is still.
  int reports = 0;
  for(int i = 0; i != 20; ++i) {
    if(auto level = classifier.update(tilted)) {
      zassert_equal(*level, activity_level::still);
      ++reports;
    }
  }
  zassert_equal(reports, 6); // 600 samples.
}

ZTEST(motion, test_pack_refuses_a_buffer_that_is_too_small) {
  std::array<accelerometer_sample, 2> samples{};
  std::array<std::uint8_t, accelerometer_header_size + 2 * accelerometer_sample_size - 1> small{};
  small.fill(0xaa);
  zassert_equal(pack_accelerometer_samples(1, 100, samples, small), 0);
  zassert_equal(small[0], 0xaa, "nothing written");
}

ZTEST(motion, test_fifo_status_decoding) {
  zassert_equal(fifo_entries(0x9f), 0x1f);
  zassert_false(fifo_overflowed(0x1f));
  zassert_true(fifo_overflowed(0x20));
}

ZTEST(motion, test_fifo_watchdog_recovers_after_a_second_and_gives_up_on_the_third) {
  using namespace std::chrono_literals;
  fifo_watchdog dog;
  using verdict = fifo_watchdog::verdict;
  for(int i = 0; i != 4; ++i) {
    zassert_equal(dog.poll(false, 200ms), verdict::ok);
  }
  zassert_equal(dog.poll(false, 200ms), verdict::recover);
  zassert_equal(dog.poll(true, 200ms), verdict::ok); // A healthy poll clears the history.
  for(int round = 0; round != 2; ++round) {
    zassert_equal(dog.poll(false, 1000ms), verdict::recover);
  }
  zassert_equal(dog.poll(false, 1000ms), verdict::lost);
  for(int round = 0; round != 5; ++round) {
    zassert_equal(dog.poll(false, 1000ms), verdict::still_lost, "lost is reported once, then every failure maps to the long retry");
  }
  zassert_equal(dog.poll(true, 200ms), verdict::ok);
  zassert_equal(dog.poll(false, 1000ms), verdict::recover, "a healthy poll starts over");
}

ZTEST(motion, test_activity_thresholds_are_80_and_300_mg) {
  // Swings of 40 and 42 counts alternate magnitudes 156 and 164 mg apart: deviations 78 and 82 mg; 153 and 154 counts: 298.5 and 300.5 mg.
  zassert_equal(classify_second(40), activity_level::still);
  zassert_equal(classify_second(42), activity_level::walking);
  zassert_equal(classify_second(153), activity_level::walking);
  zassert_equal(classify_second(154), activity_level::running);
}

ZTEST(motion, test_activity_window_may_span_chunks_of_any_size) {
  activity_classifier classifier;
  std::array<accelerometer_sample, 30> chunk{};
  int reports = 0;
  std::optional<activity_level> last;
  for(int i = 0; i != 7; ++i) { // 210 samples: windows complete inside chunks 4 and 7.
    for(std::size_t j = 0; j != chunk.size(); ++j) {
      chunk[j] = {0, 0, static_cast<std::int16_t>(256 + ((i * chunk.size() + j) % 2 == 0 ? 0 : 200))};
    }
    if(auto level = classifier.update(chunk)) {
      last = level;
      ++reports;
    }
  }
  zassert_equal(reports, 2);
  zassert_equal(*last, activity_level::running);
}

ZTEST(motion, test_reset_drops_the_partial_window) {
  activity_classifier classifier;
  std::array<accelerometer_sample, 60> batch{};
  zassert_false(classifier.update(batch).has_value());
  classifier.reset();
  zassert_false(classifier.update(batch).has_value(), "60 + 60 samples would have completed a window without the reset");
  zassert_true(classifier.update(std::span{batch}.first(40)).has_value());
}
```

## src/test_rf_test.cpp
```c
#include "rf_test.hpp"

#include <zephyr/ztest.h>

#include <array>

using namespace gtfog;

ZTEST_SUITE(rf_test, nullptr, nullptr, nullptr, nullptr, nullptr);

ZTEST(rf_test, test_frequency_mapping) {
  zassert_equal(rf_test_frequency_mhz(37), 2402);
  zassert_equal(rf_test_frequency_mhz(38), 2426);
  zassert_equal(rf_test_frequency_mhz(39), 2480);
  zassert_equal(rf_test_frequency_mhz(0), 2404);
  zassert_equal(rf_test_frequency_mhz(10), 2424);
  zassert_equal(rf_test_frequency_mhz(11), 2428);
  zassert_equal(rf_test_frequency_mhz(19), 2444);
  zassert_equal(rf_test_frequency_mhz(36), 2478);
  zassert_equal(rf_test_frequency_mhz(40), 0);
  zassert_equal(rf_test_frequency_mhz(255), 0);
}

ZTEST(rf_test, test_frequencies_are_distinct_and_even_spaced) {
  unsigned seen[40]{};
  for(unsigned channel = 0; channel < 40; ++channel) {
    auto mhz = rf_test_frequency_mhz(channel);
    zassert_true(mhz >= 2402 && mhz <= 2480 && mhz % 2 == 0);
    ++seen[(mhz - 2402) / 2];
  }
  for(auto count : seen) {
    zassert_equal(count, 1); // 40 channels on the 40 slots of a 2 MHz grid.
  }
}

ZTEST(rf_test, test_decode) {
  std::array<std::uint8_t, 2> good{19, 30};
  auto request = decode_rf_test(good);
  zassert_true(request.has_value());
  zassert_equal(request->channel, 19);
  zassert_equal(request->duration.count(), 30);
  std::array<std::uint8_t, 2> longest{39, 255};
  zassert_true(decode_rf_test(longest).has_value());
}

ZTEST(rf_test, test_decode_rejects) {
  std::array<std::uint8_t, 2> bad_channel{40, 30};
  std::array<std::uint8_t, 2> zero_seconds{5, 0};
  std::array<std::uint8_t, 1> short_payload{5};
  std::array<std::uint8_t, 3> long_payload{5, 30, 0};
  zassert_false(decode_rf_test(bad_channel).has_value());
  zassert_false(decode_rf_test(zero_seconds).has_value());
  zassert_false(decode_rf_test(short_payload).has_value());
  zassert_false(decode_rf_test(long_payload).has_value());
  zassert_true(is_rf_test_size(2) && !is_rf_test_size(1));
}
```
